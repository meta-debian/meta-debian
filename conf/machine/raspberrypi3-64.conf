## conf/machine/raspberrypi3-64.conf
```bitbake
MACHINEOVERRIDES = "raspberrypi3:${MACHINE}"

require conf/machine/include/tune-cortexa53.inc

SERIAL_CONSOLES ?= "115200;ttyS1"

UBOOT_MACHINE ?= "rpi_3_defconfig"
IMAGE_INSTALL_append += " u-boot"
```
