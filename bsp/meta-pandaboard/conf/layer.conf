## bsp/meta-pandaboard/conf/layer.conf
```bitbake
# We have a conf and classes directory, add to BBPATH
BBPATH =. "${LAYERDIR}:"

# We have recipes-* directories, add to BBFILES
BBFILES += "${LAYERDIR}/recipes-*/*/*.bb \
            ${LAYERDIR}/recipes-*/*/*.bbappend"

BBFILE_COLLECTIONS += "pandaboard"
BBFILE_PATTERN_pandaboard = "^${LAYERDIR}/"
BBFILE_PRIORITY_pandaboard = "11"

# This should only be incremented on significant changes that will
# cause compatibility issues with other layers
LAYERVERSION_pandaboard = "1"

LAYERDEPENDS_pandaboard = "core debian"
```

## bsp/meta-pandaboard/conf/machine/pandaboard.conf
```bitbake
#@TYPE: Machine
#@NAME: Pandaboard version 1
#@DESCRIPTION: Machine configuration for the Pandaboard version 1
# SoC: OMAP4460
# CPU: ARM-CORTEX-A9

DEFAULTTUNE ?= "cortexa9thf-neon"
require conf/machine/include/tune-cortexa9.inc

KERNEL_IMAGETYPE = "uImage"

IMAGE_FSTYPES ?= "tar.bz2 ext3"

EXTRA_IMAGEDEPENDS += "u-boot"

SERIAL_CONSOLE = "115200 ttyO2"

UBOOT_MACHINE ?= "omap4_panda_config"

UBOOT_ENTRYPOINT = "0x80008000"
UBOOT_LOADADDRESS = "0x80008000"
```

## bsp/meta-raspberrypi/conf/layer.conf
```bitbake
# We have a conf and classes directory, add to BBPATH
BBPATH =. "${LAYERDIR}:"

# We have recipes-* directories, add to BBFILES
BBFILES += "${LAYERDIR}/recipes-*/*/*.bb \
            ${LAYERDIR}/recipes-*/*/*.bbappend"

BBFILE_COLLECTIONS += "debian-raspberrypi"
BBFILE_PATTERN_debian-raspberrypi = "^${LAYERDIR}/"
BBFILE_PRIORITY_debian-raspberrypi = "10"

# This should only be incremented on significant changes that will
# cause compatibility issues with other layers
LAYERVERSION_debian-raspberrypi = "1"

LAYERDEPENDS_debian-raspberrypi = "debian raspberrypi"

LAYERSERIES_COMPAT_debian-raspberrypi = "warrior"

IMAGE_FSTYPES_append_deby-tiny = " rpi-sdimg"
SERIAL_CONSOLES_append_deby-tiny = " 115200;tty1"

VIRTUAL_KERNEL = "linux-raspberrypi"
```

## bsp/meta-raspberrypi/conf/machine/raspberrypi-v1.conf
```bitbake
#@TYPE: Machine
#@NAME: RaspberryPi version 1
#@DESCRIPTION: Machine configuration for the RaspberryPi version 1
# SoC: Broadcom BCM2835
# CPU: ARM1176JZF-S

# enable hardware floating point (hf)
DEFAULTTUNE ?= "arm1176jzfshf"
require conf/machine/include/tune-arm1176jzf-s.inc

IMAGE_FSTYPES ?= "tar.bz2 ext3"

SERIAL_CONSOLE = "115200 ttyAMA0"

LINUX_DEFCONFIG ?= "bcm2835_defconfig"
LINUX_CONFIG_APPEND ?= "${MACHINE}.config"
KERNEL_DEVICETREE ?= "bcm2835-rpi-b.dtb"
```

## bsp/meta-swupdate/conf/layer.conf
```bitbake
# We have a conf and classes directory, add to BBPATH
BBPATH =. "${LAYERDIR}:"

# We have recipes-* directories, add to BBFILES
BBFILES += "${LAYERDIR}/recipes-*/*/*.bb \
            ${LAYERDIR}/recipes-*/*/*.bbappend"

BBFILE_COLLECTIONS += "debian-swupdate"
BBFILE_PATTERN_debian-swupdate = "^${LAYERDIR}/"
BBFILE_PRIORITY_debian-swupdate = "10"

# This should only be incremented on significant changes that will
# cause compatibility issues with other layers
LAYERVERSION_debian-swupdate = "1"

LAYERDEPENDS_debian-swupdate = "debian swupdate"

LAYERSERIES_COMPAT_debian-swupdate = "warrior"

PREFERRED_PROVIDER_u-boot-fw-utils = "libubootenv"
IMAGE_FSTYPES_append = " ext4"
```

## bsp/meta-ti/conf/layer.conf
```bitbake
# We have a conf and classes directory, add to BBPATH
BBPATH =. "${LAYERDIR}:"

# We have recipes-* directories, add to BBFILES
BBFILES += "${LAYERDIR}/recipes-*/*/*.bb \
            ${LAYERDIR}/recipes-*/*/*.bbappend"

BBFILE_COLLECTIONS += "dti"
BBFILE_PATTERN_dti = "^${LAYERDIR}/"
BBFILE_PRIORITY_dti = "10"

# This should only be incremented on significant changes that will
# cause compatibility issues with other layers
LAYERVERSION_dti = "1"

LAYERDEPENDS_dti = "debian meta-ti"

LAYERSERIES_COMPAT_dti = "warrior"
```

## bsp/meta-vmware/conf/layer.conf
```bitbake
# We have a conf and classes directory, add to BBPATH
BBPATH =. "${LAYERDIR}:"

# We have recipes-* directories, add to BBFILES
BBFILES += "${LAYERDIR}/recipes-*/*/*.bb \
            ${LAYERDIR}/recipes-*/*/*.bbappend"

BBFILE_COLLECTIONS += "vmware"
BBFILE_PATTERN_vmware = "^${LAYERDIR}/"
BBFILE_PRIORITY_vmware = "11"

# This should only be incremented on significant changes that will
# cause compatibility issues with other layers
LAYERVERSION_vmware = "1"

LAYERDEPENDS_vmware = "core debian"
```

## bsp/meta-vmware/conf/machine/vmware-32.conf
```bitbake
#@TYPE: Machine
#@NAME: vmware-32
#@DESCRIPTION: Machine configuration for VMware Player (32bit)

DEFAULTTUNE ?= "core2-32"
require conf/machine/include/tune-core2.inc

KERNEL_IMAGETYPE ?= "bzImage"

SERIAL_CONSOLES ?= ""

IMAGE_FSTYPES ?= "tar.bz2 ext4"
```

## bsp/meta-vmware/conf/machine/vmware-64.conf
```bitbake
#@TYPE: Machine
#@NAME: vmware-64
#@DESCRIPTION: Machine configuration for VMware Player (64bit)

DEFAULTTUNE ?= "core2-64"
require conf/machine/include/tune-core2.inc

KERNEL_IMAGETYPE ?= "bzImage"

SERIAL_CONSOLES ?= ""

IMAGE_FSTYPES ?= "tar.bz2 ext4"
```

## conf/bblayers.conf.sample
```bitbake
# LAYER_CONF_VERSION is increased each time build/conf/bblayers.conf
# changes incompatibly
LCONF_VERSION = "6"

BBPATH = "${TOPDIR}"
BBFILES ?= ""

BBLAYERS ?= " \
  /home/hayashi/yocto/poky/meta \
  /home/hayashi/yocto/poky/meta-debian \
  "
BBLAYERS_NON_REMOVABLE ?= " \
  /home/hayashi/yocto/poky/meta \
  "
```

## conf/distro/debian.conf
```bitbake
DISTRO = "debian"
DISTRO_NAME = "Debian"
DISTRO_VERSION = "8.0"
DISTRO_CODENAME = "jessie"
SDK_VENDOR = "-debiansdk"
SDK_VERSION := "${@'${DISTRO_VERSION}'}"

# would be moved into github.com/meta-debian
DEBIAN_GIT_URI ??= "git://github.com/ystk"
DEBIAN_GIT_PROTOCOL ??= "https"

LINUX_GIT_URI ??= "git://github.com/meta-debian"
LINUX_GIT_REPO ??= "linux-ltsi.git"
LINUX_GIT_PROTOCOL ??= "${DEBIAN_GIT_PROTOCOL}"
LINUX_GIT_SRCREV ??= "3.14.28-ltsi"

MAINTAINER = "meta-debian Development Team"

TARGET_VENDOR = "-debian"

#
# distro/poky.conf based configuration
#

LOCALCONF_VERSION = "1"
LAYER_CONF_VERSION ?= "6"

SDK_NAME = "${DISTRO}-${TCLIBC}-${SDK_ARCH}-${IMAGE_BASENAME}-${TUNE_PKGARCH}"
SDKPATH = "/opt/${DISTRO}/${SDK_VERSION}"

EXTRAOPKGCONFIG = "poky-feed-config-opkg"

TCLIBCAPPEND = ""

QEMU_TARGETS ?= "arm i386 mips mipsel ppc x86_64"
# Other QEMU_TARGETS "mips64 mips64el sh4"

# no mirror for fetching debian source codes
PREMIRRORS = ""
MIRRORS = ""

# The CONNECTIVITY_CHECK_URI's are used to test whether we can succesfully
# fetch from the network (and warn you if not). To disable the test set
# the variable to be empty.
# Git example url: git://git.yoctoproject.org/yocto-firewall-test;protocol=git;rev=HEAD

DEBIAN_CONNECTIVITY_CHECK_REPO ??= \
"${DEBIAN_GIT_URI}/debian-glibc.git"

CONNECTIVITY_CHECK_URIS ??= " \
${DEBIAN_CONNECTIVITY_CHECK_REPO};\
protocol=${DEBIAN_GIT_PROTOCOL};\
rev=${DISTRO_CODENAME}-master\
"

# currently only Debian 8.0 jessie is tested
SANITY_TESTED_DISTROS ?= " \
            Debian-8.0 \n \
            "

# Default hash policy for distro
BB_SIGNATURE_HANDLER ?= 'OEBasicHash'
#
# OELAYOUT_ABI allows us to notify users when the format of TMPDIR changes in 
# an incompatible way. Such changes should usually be detailed in the commit
# that breaks the format and have been previously discussed on the mailing list 
# with general agreement from the core team.
#
OELAYOUT_ABI = "8"

# QA check settings - a little stricter than the OE-Core defaults
WARN_QA = "textrel files-invalid incompatible-license xorg-driver-abi libdir \
           unknown-configure-option"
ERROR_QA = "dev-so debug-deps dev-deps debug-files arch pkgconfig la perms \
            useless-rpaths rpaths staticdev ldflags pkgvarcheck already-stripped \
            compile-host-path dep-cmp installed-vs-shipped install-host-path \
            packages-list perm-config perm-line perm-link pkgv-undefined \
            pn-overrides split-strip var-undefined version-going-backwards"

#
# distro/poky-tiny.conf based configuration
#

# Disable wide char support for ncurses as we don't include it in
# in the LIBC features below.
ENABLE_WIDEC="false"
# Drop native language support. This removes the
# eglibc->bash->gettext->libc-posix-clang-wchar dependency.
USE_NLS="no"
# Reconfigure eglibc for a smaller installation
# Comment out any of the lines below to disable them in the build
DISTRO_FEATURES_LIBC_TINY = "libc-libm libc-crypt"
DISTRO_FEATURES_LIBC_TINY_append_x86-64 = " libc-libm-big"
# Required for "who"
DISTRO_FEATURES_LIBC_MINIMAL = "libc-utmp libc-getlogin"
DISTRO_FEATURES_LIBC_REGEX = "libc-posix-regexp"
DISTRO_FEATURES_LIBC_NET = "libc-inet libc-nis"
DISTRO_FEATURES_LIBC = "${DISTRO_FEATURES_LIBC_TINY} \
                        ${DISTRO_FEATURES_LIBC_MINIMAL} \
                        ${DISTRO_FEATURES_LIBC_REGEX} \
                        ${DISTRO_FEATURES_LIBC_NET} \
                       "

# Comment out any of the lines below to disable them in the build
# DISTRO_FEATURES options:
# alsa bluetooth ext2 irda pcmcia usbgadget usbhost wifi nfs zeroconf pci
DISTRO_FEATURES_TINY = "pci"
DISTRO_FEATURES_NET = "ipv4"
DISTRO_FEATURES_USB = "usbhost"
#DISTRO_FEATURES_USBGADGET = "usbgadget"
#DISTRO_FEATURES_WIFI = "wifi"

DISTRO_FEATURES = "${DISTRO_FEATURES_TINY} \
                   ${DISTRO_FEATURES_NET} \
                   ${DISTRO_FEATURES_USB} \
                   ${DISTRO_FEATURES_USBGADGET} \
                   ${DISTRO_FEATURES_WIFI} \
                   ${DISTRO_FEATURES_LIBC} \
                  "

# Use tmpdevfs and the busybox runtime services
VIRTUAL-RUNTIME_dev_manager = ""
VIRTUAL-RUNTIME_login_manager = ""
VIRTUAL-RUNTIME_init_manager = "tiny-init"
VIRTUAL-RUNTIME_initscripts = ""
VIRTUAL-RUNTIME_keymaps = ""

# By default, support only commonly used types
# Don't build live because it pulls a lot of dependencies
IMAGE_FSTYPES = "ext3 tar.gz"

# Drop v86d from qemu dependency list (we support serial)
# Drop grub from meta-intel BSPs
# FIXME: A different mechanism is needed here. We could define -tiny
#        variants of all compatible machines, but that leads to a lot
#        more machine configs to maintain long term.
MACHINE_ESSENTIAL_EXTRA_RDEPENDS = ""

# The mtrace script included by eglibc is a perl script. This means the system
# will build perl in case this package is installed. Since we don't care about
# this script for the purposes of tiny, remove the dependency from here.
RDEPENDS_${PN}-mtrace_pn-eglibc = ""

INHERIT += "blacklist"
PNBLACKLIST[build-appliance-image] = "not buildable with poky-tiny"
PNBLACKLIST[core-image-base] = "not buildable with poky-tiny"
PNBLACKLIST[core-image-clutter] = "not buildable with poky-tiny"
PNBLACKLIST[core-image-directfb] = "not buildable with poky-tiny"
PNBLACKLIST[core-image-full-cmdline] = "not buildable with poky-tiny"
PNBLACKLIST[core-image-lsb] = "not buildable with poky-tiny"
PNBLACKLIST[core-image-lsb-dev] = "not buildable with poky-tiny"
PNBLACKLIST[core-image-lsb-sdk] = "not buildable with poky-tiny"
PNBLACKLIST[core-image-rt] = "not buildable with poky-tiny"
PNBLACKLIST[core-image-rt-sdk] = "not buildable with poky-tiny"
PNBLACKLIST[core-image-sato] = "not buildable with poky-tiny"
PNBLACKLIST[core-image-sato-dev] = "not buildable with poky-tiny"
PNBLACKLIST[core-image-sato-sdk] = "not buildable with poky-tiny"
PNBLACKLIST[core-image-x11] = "not buildable with poky-tiny"
PNBLACKLIST[qt4e-demo-image] = "not buildable with poky-tiny"
PNBLACKLIST[core-image-weston] = "not buildable with poky-tiny"

# Disable python usage in opkg-utils since it won't build with tiny config
PACKAGECONFIG_pn-opkg-utils = ""

#
# Disable all PREFERRED_VERSIONs in default distro configuration.
# Specify preferred provider for some targets.
# This means all recipes in meta-debian have higher priority than
# recipes in other layers and bitbake automatically chooses them
# by default, while BBFILE_PRIORITY_debian is higher than others.
#

# use toolchain mode for Debian instead of the default
TCMODE ?= "debian"
require conf/distro/include/debian-preferred-version.inc
require conf/distro/include/debian-preferred-provider.inc

#
# features
#

# Disable unneeded features appended by bitbake.conf,
# which are not able to be disabled for OpenEmbedded build system.
# See "Feature Backfilling" in the Yocto Project reference manual.
DISTRO_FEATURES_BACKFILL_CONSIDERED = "pulseaudio sysvinit"
```

## conf/distro/deby-tiny.conf
```bitbake
require conf/distro/poky-tiny.conf
require deby.inc

DISTRO = "deby-tiny"
DISTROOVERRIDES = "deby:deby-tiny"

# meta-debian has not supported "musl" yet.
TCLIBC = "glibc"
```

## conf/distro/deby.inc
```bitbake
DISTRO_NAME = "Deby"
DISTRO_VERSION = "10.0"
DISTRO_CODENAME = "buster"
SDK_VENDOR = "-debysdk"
SDK_VERSION := "${DISTRO_VERSION}"

MAINTAINER = "meta-debian Development Team"
TARGET_VENDOR = "-deby"

LINUX_GIT_URI ??= "git://git.kernel.org/pub/scm/linux/kernel/git/cip"
LINUX_GIT_PROTOCOL ??= "https"
LINUX_GIT_PREFIX ??= ""
LINUX_GIT_REPO ??= "linux-cip.git"
LINUX_GIT_SRCREV ??= "linux-4.19.y-cip"

# Add an eventhandler that generates DEBIAN_SRC_URI information
# from Debian apt repository.
INHERIT += "debian-source"

# currently only Debian 10 buster is tested
# In Debian, tested distro names given by distro_identifier()
# depend on the following command and files:
# 1. lsb_release -ir => Debian-testing
# 2. /etc/lsb-release => (no package provide this file)
# 3. /etc/os-release => debian
SANITY_TESTED_DISTROS ?= " \
Debian-testing \n \
debian \n \
"

# use toolchain mode for Debian instead of the default
TCMODE ?= "deby"

# preferred providers and versions
require conf/distro/include/debian-preferred-provider.inc
```
