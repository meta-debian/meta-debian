## conf/distro/emlinux.conf
```bitbake
DISTRO = "emlinux"
DISTRO_NAME = "EMLinux"
DISTRO_VERSION = "2.1"
DISTRO_CODENAME = "buster"
SDK_VENDOR = "-emlinuxsdk"
SDK_VERSION := "${@'${DISTRO_VERSION}'.replace('snapshot-${DATE}','snapshot')}"

MAINTAINER = "Cybertrust Japan"

TARGET_VENDOR = "-emlinux"

LOCALCONF_VERSION = "1"

DISTRO_VERSION[vardepsexclude] = "DATE"
SDK_VERSION[vardepsexclude] = "DATE"

# Override these in poky based distros
EMLINUX_DEFAULT_DISTRO_FEATURES = "largefile opengl ptest multiarch wayland vulkan systemd"
EMLINUX_DEFAULT_EXTRA_RDEPENDS = "packagegroup-core-boot"

DISTRO_FEATURES ?= "${DISTRO_FEATURES_DEFAULT} ${DISTRO_FEATURES_LIBC} ${EMLINUX_DEFAULT_DISTRO_FEATURES}"

SDK_NAME = "${DISTRO}-${TCLIBC}-${SDK_ARCH}-${IMAGE_BASENAME}-${TUNE_PKGARCH}"
SDKPATH = "/opt/${DISTRO}/${SDK_VERSION}"

DISTRO_EXTRA_RDEPENDS += " ${EMLINUX_DEFAULT_EXTRA_RDEPENDS}"

MISC_GIT_URI ??= "git://github.com/ystk"
MISC_GIT_PROTOCOL ??= "https"
MISC_GIT_PREFIX ??= ""

LINUX_GIT_URI ?= "git://git.kernel.org/pub/scm/linux/kernel/git/cip"
LINUX_GIT_PROTOCOL ?= "https"
LINUX_GIT_PREFIX ?= ""
LINUX_GIT_REPO ?= "linux-cip.git"
LINUX_GIT_BRANCH ?= "linux-4.19.y-cip"
#
# If you want to use latest revision of the kernel, append the following line
# to local.conf
#
# LINUX_GIT_SRCREV = "${LINUX_GIT_BRANCH}"
#
LINUX_GIT_SRCREV ?= "52f7171e0b7fcf44b37d9dc270de2576bcefe169"

BOOTLOADER_GIT_URI ??= "git://github.com/ystk"
BOOTLOADER_GIT_PROTOCOL ??= "https"
BOOTLOADER_GIT_PREFIX ??= ""

# use toolchain mode for Debian instead of the default
TCMODE ?= "emlinux"

# Add an eventhandler that generates DEBIAN_SRC_URI information
# from Debian apt repository.
INHERIT += "debian-source"

QEMU_TARGETS ?= "arm aarch64 i386 x86_64"

PREMIRRORS ??= "\
bzr://.*/.*   http://downloads.yoctoproject.org/mirror/sources/ \n \
cvs://.*/.*   http://downloads.yoctoproject.org/mirror/sources/ \n \
git://.*/.*   http://downloads.yoctoproject.org/mirror/sources/ \n \
gitsm://.*/.* http://downloads.yoctoproject.org/mirror/sources/ \n \
hg://.*/.*    http://downloads.yoctoproject.org/mirror/sources/ \n \
osc://.*/.*   http://downloads.yoctoproject.org/mirror/sources/ \n \
p4://.*/.*    http://downloads.yoctoproject.org/mirror/sources/ \n \
svn://.*/.*   http://downloads.yoctoproject.org/mirror/sources/ \n"

MIRRORS =+ "\
ftp://.*/.*      http://downloads.yoctoproject.org/mirror/sources/ \n \
http://.*/.*     http://downloads.yoctoproject.org/mirror/sources/ \n \
https://.*/.*    http://downloads.yoctoproject.org/mirror/sources/ \n"

SANITY_TESTED_DISTROS ?= " \
            ubuntu-18.04 \n \
            "

# preferred providers and versions
require conf/distro/include/emlinux-preferred-provider.inc

#
# OELAYOUT_ABI allows us to notify users when the format of TMPDIR changes in
# an incompatible way. Such changes should usually be detailed in the commit
# that breaks the format and have been previously discussed on the mailing list
# with general agreement from the core team.
#
OELAYOUT_ABI = "12"

# QA check settings - a little stricter than the OE-Core defaults
WARN_TO_ERROR_QA = "already-stripped compile-host-path install-host-path \
                    installed-vs-shipped ldflags pn-overrides rpaths staticdev \
                    unknown-configure-option useless-rpaths"
WARN_QA_remove = "${WARN_TO_ERROR_QA}"
ERROR_QA_append = " ${WARN_TO_ERROR_QA}"

require conf/distro/include/no-static-libs.inc
```

## conf/distro/include/debian-preferred-provider.inc
```bitbake
# use simple kernel recipes instead of linux-yocto
VIRTUAL_KERNEL ??= "linux-base"
PREFERRED_PROVIDER_virtual/kernel = "${VIRTUAL_KERNEL}"
PREFERRED_PROVIDER_linux-libc-headers = "linux-libc-headers-base"
PREFERRED_PROVIDER_nativesdk-linux-libc-headers = "nativesdk-linux-libc-headers-base"
```

## conf/distro/include/debian-preferred-version.inc
```bitbake
# disable preferred versions defined in
# conf/distro/include/default-versions.inc
PREFERRED_VERSION_python = ""
PREFERRED_VERSION_python-native = ""
PREFERRED_VERSION_liberation-fonts = ""
PREFERRED_VERSION_xf86-video-intel = ""
```

## conf/distro/include/default-versions.inc
```bitbake
#
# Temporary overwrite db-native version in meta
# to use recipe in meta-debian
#
PREFERRED_VERSION_db-native = ""
```

## conf/distro/include/emlinux-preferred-provider.inc
```bitbake
# use simple kernel recipes instead of linux-yocto
PREFERRED_PROVIDER_virtual/kernel ?= "linux-base"
PREFERRED_PROVIDER_linux-libc-headers ?= "linux-libc-headers-base"
PREFERRED_PROVIDER_nativesdk-linux-libc-headers ?= "nativesdk-linux-libc-headers-base"
```

## conf/distro/include/nondebian-preferred-version.inc
```bitbake
# essential non-Debian native tools are also
# managed in meta-debian project repositories

PREFERRED_VERSION_pseudo = "1.8.1+git%"
PREFERRED_VERSION_pseudo-native = "1.8.1+git%"
PREFERRED_VERSION_nativesdk-pseudo = "1.8.1+git%"

PREFERRED_VERSION_gnu-config = "20150728+git%"
PREFERRED_VERSION_gnu-config-native = "20150728+git%"
PREFERRED_VERSION_nativesdk-gnu-config = "20150728+git%"
```

## conf/distro/include/tcmode-deby.inc
```bitbake
#
# toolchain configuration for Debian
#
# most definitions are same as tcmode-default.inc,
# except PREFERRED_VERSION definitions are removed
#

PREFERRED_PROVIDER_virtual/${TARGET_PREFIX}binutils = "binutils-cross-${TARGET_ARCH}"
PREFERRED_PROVIDER_virtual/${TARGET_PREFIX}gcc = "gcc-cross-${TARGET_ARCH}"
PREFERRED_PROVIDER_virtual/${TARGET_PREFIX}g++ = "gcc-cross-${TARGET_ARCH}"
PREFERRED_PROVIDER_virtual/${TARGET_PREFIX}compilerlibs = "gcc-runtime"
PREFERRED_PROVIDER_gdb = "gdb"

PREFERRED_PROVIDER_virtual/${SDK_PREFIX}binutils-crosssdk ?= "binutils-crosssdk-${SDK_SYS}"
PREFERRED_PROVIDER_virtual/${SDK_PREFIX}gcc = "gcc-crosssdk-${SDK_SYS}"
PREFERRED_PROVIDER_virtual/${SDK_PREFIX}g++ = "gcc-crosssdk-${SDK_SYS}"
PREFERRED_PROVIDER_virtual/${SDK_PREFIX}compilerlibs = "nativesdk-gcc-runtime"

# Default libc config
PREFERRED_PROVIDER_virtual/${TARGET_PREFIX}libc-initial = "${TCLIBC}-initial"
PREFERRED_PROVIDER_virtual/nativesdk-${SDK_PREFIX}libc-initial ?= "nativesdk-glibc-initial"
PREFERRED_PROVIDER_virtual/gettext ??= "gettext"
```

## conf/distro/include/tcmode-emlinux.inc
```bitbake
#
# toolchain configuration for Debian
#
# most definitions are same as tcmode-default.inc,
# except PREFERRED_VERSION definitions are removed
#

PREFERRED_PROVIDER_virtual/${TARGET_PREFIX}binutils = "binutils-cross-${TARGET_ARCH}"
PREFERRED_PROVIDER_virtual/${TARGET_PREFIX}gcc-initial = "gcc-cross-initial-${TARGET_ARCH}"
PREFERRED_PROVIDER_virtual/${TARGET_PREFIX}gcc = "gcc-cross-${TARGET_ARCH}"
PREFERRED_PROVIDER_virtual/${TARGET_PREFIX}g++ = "gcc-cross-${TARGET_ARCH}"
PREFERRED_PROVIDER_virtual/${TARGET_PREFIX}compilerlibs = "gcc-runtime"
PREFERRED_PROVIDER_gdb = "gdb"

PREFERRED_PROVIDER_virtual/${SDK_PREFIX}binutils-crosssdk ?= "binutils-crosssdk-${SDK_SYS}"
PREFERRED_PROVIDER_virtual/${SDK_PREFIX}gcc-initial = "gcc-crosssdk-initial-${SDK_SYS}"
PREFERRED_PROVIDER_virtual/${SDK_PREFIX}gcc = "gcc-crosssdk-${SDK_SYS}"
PREFERRED_PROVIDER_virtual/${SDK_PREFIX}g++ = "gcc-crosssdk-${SDK_SYS}"
PREFERRED_PROVIDER_virtual/${SDK_PREFIX}compilerlibs = "nativesdk-gcc-runtime"

# Default libc config
PREFERRED_PROVIDER_virtual/${TARGET_PREFIX}libc-for-gcc = "${TCLIBC}"
PREFERRED_PROVIDER_virtual/nativesdk-${SDK_PREFIX}libc-for-gcc ?= "nativesdk-glibc"
PREFERRED_PROVIDER_virtual/${TARGET_PREFIX}libc-initial = "${TCLIBC}-initial"
PREFERRED_PROVIDER_virtual/nativesdk-${SDK_PREFIX}libc-initial ?= "nativesdk-glibc-initial"
PREFERRED_PROVIDER_virtual/gettext ??= "gettext"
```

## conf/layer.conf
```bitbake
# We have a conf and classes directory, add to BBPATH
BBPATH =. "${LAYERDIR}:"

# BBFILES_CORE is a list of recipes in OE-Core layer that recipes in
# this layer depend on. This variable is not used by default, but
# it helps users to do
#   1. "bitbake world" for recipes in this layer
#   2. Prevent users from using OE-Core recipes unintentionally
# Usage: Add the following definition in local.conf:
#   BBFILES = "${BBFILES_CORE} ${BBFILES_DEBIAN}"
#
# Here is a list of dependencies:
#   - shadow-sysroot: useradd.bbclass
#   - run-postinsts: rpm
#   - depmodwrapper-cross: linux-base
#   - Others: Corresponding .bbappend
BBFILES_CORE = "${COREBASE}/meta/recipes-core/packagegroups/packagegroup-core-boot.bb \
                ${COREBASE}/meta/recipes-core/packagegroups/packagegroup-core-standalone-sdk-target.bb \
                ${COREBASE}/meta/recipes-core/packagegroups/nativesdk-packagegroup-sdk-host.bb \
                ${COREBASE}/meta/recipes-core/images/core-image-minimal.bb \
                ${COREBASE}/meta/recipes-core/meta/meta-toolchain.bb \
                ${COREBASE}/meta/recipes-devtools/gnu-config/gnu-config_git.bb \
                ${COREBASE}/meta/recipes-devtools/pseudo/pseudo_git.bb \
                ${COREBASE}/meta/recipes-extended/shadow/shadow-sysroot_4.2.1.bb \
                ${COREBASE}/meta/recipes-devtools/run-postinsts/run-postinsts_1.0.bb \
                ${COREBASE}/meta/recipes-kernel/kmod/depmodwrapper-cross_1.0.bb \
               "

BBFILES_DEBIAN = "${LAYERDIR}/recipes-*/*/*.bb \
                  ${LAYERDIR}/recipes-*/*/*.bbappend"
# We have recipes-* directories, add to BBFILES
BBFILES += "${BBFILES_DEBIAN}"

BBFILE_COLLECTIONS += "debian"
BBFILE_PATTERN_debian = "^${LAYERDIR}/"
BBFILE_PRIORITY_debian = "10"

# This should only be incremented on significant changes that will
# cause compatibility issues with other layers
LAYERVERSION_debian = "1"

LAYERDEPENDS_debian = "core"
```

## conf/machine/qemuarmhf-ca9.conf
```bitbake
#@TYPE: Machine
#@NAME: arm_vexpress-v2p-ca9
#@DESCRIPTION: arm_vexpress-v2p-ca9

require conf/machine/include/qemu.inc
require conf/machine/include/tune-cortexa9.inc

KERNEL_IMAGETYPE = "zImage"

SERIAL_CONSOLES ?= "115200;ttyAMA0 115200;ttyAMA1"

# For runqemuhf
QB_SYSTEM_NAME = "qemu-system-arm"
QB_MACHINE = "-machine vexpress-a9"
QB_KERNEL_CMDLINE_APPEND = "console=ttyAMA0,115200 console=tty root=/dev/mmcblk0"
QB_OPT_APPEND = "-show-cursor -usb"
QB_DTB = "vexpress-v2p-ca9.dtb"
QB_MEM = "-m 512"
QB_ROOTFS_OPT = "-drive id=disk0,file=@ROOTFS@,if=sd,format=raw"
QB_NETWORK_DEVICE = "-net nic,macaddr=@MAC@"
```
